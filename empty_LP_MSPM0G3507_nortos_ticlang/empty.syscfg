/**
 * @cliArgs --device "MSPM0G350X" --part "Default" --package "LQFP-64(PM)" --product "mspm0_sdk@2.10.00.04"
 * @versions {"tool":"1.26.0+4407"}
 */

/**
 * Import the modules used in this configuration.
 */
const ADC12         = scripting.addModule("/ti/driverlib/ADC12", {}, false);
const ADC121        = ADC12.addInstance();
const GPIO          = scripting.addModule("/ti/driverlib/GPIO", {}, false);
const GPIO1         = GPIO.addInstance();
const SYSCTL        = scripting.addModule("/ti/driverlib/SYSCTL");
const TIMER         = scripting.addModule("/ti/driverlib/TIMER", {}, false);
const TIMER1        = TIMER.addInstance();
const ProjectConfig = scripting.addModule("/ti/project_config/ProjectConfig");

/**
 * Write custom configuration values to the imported modules.
 */
ADC121.$name               = "ADC12_0";
ADC121.repeatMode          = true;
ADC121.trigSrc             = "DL_ADC12_TRIG_SRC_EVENT";
ADC121.adcMem0trig         = "DL_ADC12_TRIGGER_MODE_TRIGGER_NEXT";
ADC121.powerDownMode       = "DL_ADC12_POWER_DOWN_MODE_MANUAL";
ADC121.sampleTime0         = "100 ns";
ADC121.enabledInterrupts   = ["DL_ADC12_INTERRUPT_MEM0_RESULT_LOADED"];
ADC121.subChanID           = 1;
ADC121.adcPin0Config.$name = "ti_driverlib_gpio_GPIOPinGeneric0";

const Board = scripting.addModule("/ti/driverlib/Board", {}, false);

GPIO1.$name                          = "GPIO_GRP_0";
GPIO1.associatedPins.create(8);
GPIO1.associatedPins[0].$name        = "PIN_0";
GPIO1.associatedPins[0].assignedPort = "PORTB";
GPIO1.associatedPins[0].assignedPin  = "0";
GPIO1.associatedPins[1].$name        = "PIN_1";
GPIO1.associatedPins[1].assignedPort = "PORTB";
GPIO1.associatedPins[1].assignedPin  = "1";
GPIO1.associatedPins[2].$name        = "PIN_2";
GPIO1.associatedPins[2].assignedPort = "PORTB";
GPIO1.associatedPins[2].assignedPin  = "2";
GPIO1.associatedPins[3].$name        = "PIN_3";
GPIO1.associatedPins[3].assignedPort = "PORTB";
GPIO1.associatedPins[3].assignedPin  = "3";
GPIO1.associatedPins[4].$name        = "PIN_4";
GPIO1.associatedPins[4].assignedPort = "PORTB";
GPIO1.associatedPins[4].assignedPin  = "4";
GPIO1.associatedPins[5].$name        = "PIN_5";
GPIO1.associatedPins[5].assignedPort = "PORTB";
GPIO1.associatedPins[5].assignedPin  = "6";
GPIO1.associatedPins[6].$name        = "PIN_6";
GPIO1.associatedPins[6].assignedPort = "PORTB";
GPIO1.associatedPins[6].assignedPin  = "7";
GPIO1.associatedPins[7].$name        = "PIN_7";
GPIO1.associatedPins[7].assignedPort = "PORTB";
GPIO1.associatedPins[7].assignedPin  = "8";

SYSCTL.forceDefaultClkConfig = true;

TIMER1.$name                       = "TIMER_0";
TIMER1.timerMode                   = "PERIODIC";
TIMER1.timerStartTimer             = true;
TIMER1.timerPeriod                 = "22.67 us";
TIMER1.event1PublisherChannel      = 1;
TIMER1.event1ControllerInterruptEn = ["ZERO_EVENT"];

ProjectConfig.genLibCMSIS = true;

/**
 * Pinmux solution for unlocked pins/peripherals. This ensures that minor changes to the automatic solver in a future
 * version of the tool will not impact the pinmux you originally saw.  These lines can be completely deleted in order to
 * re-solve from scratch.
 */
ADC121.peripheral.$suggestSolution           = "ADC0";
ADC121.peripheral.adcPin0.$suggestSolution   = "PA27";
Board.peripheral.$suggestSolution            = "DEBUGSS";
Board.peripheral.swclkPin.$suggestSolution   = "PA20";
Board.peripheral.swdioPin.$suggestSolution   = "PA19";
GPIO1.associatedPins[0].pin.$suggestSolution = "PB0";
GPIO1.associatedPins[1].pin.$suggestSolution = "PB1";
GPIO1.associatedPins[2].pin.$suggestSolution = "PB2";
GPIO1.associatedPins[3].pin.$suggestSolution = "PB3";
GPIO1.associatedPins[4].pin.$suggestSolution = "PB4";
GPIO1.associatedPins[5].pin.$suggestSolution = "PB6";
GPIO1.associatedPins[6].pin.$suggestSolution = "PB7";
GPIO1.associatedPins[7].pin.$suggestSolution = "PB8";
SYSCTL.peripheral.$suggestSolution           = "SYSCTL";
TIMER1.peripheral.$suggestSolution           = "TIMA0";
